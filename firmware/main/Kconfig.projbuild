## firmware/main/Kconfig.projbuild
```kconfig
menu "Mounam board wiring"
    config MOUNAM_BCLK
        int "Shared I2S BCLK GPIO"
        range 1 21
        default 4
    config MOUNAM_WS
        int "Shared I2S WS GPIO"
        range 1 21
        default 5
    config MOUNAM_DIN
        int "Two microphones shared SD GPIO"
        range 1 21
        default 6
    config MOUNAM_DOUT
        int "DAC DIN GPIO"
        range 1 21
        default 7
    config MOUNAM_PROBE
        int "DSP timing probe GPIO"
        range 1 21
        default 10
    config MOUNAM_MUTE
        int "DAC active-high MUTE GPIO (wire to DAC MUTE)"
        range 1 21
        default 8
endmenu
```

## firmware/sdkconfig.defaults
```kconfig
CONFIG_IDF_TARGET="esp32s3"
CONFIG_ESPTOOLPY_FLASHSIZE_16MB=y
CONFIG_ESPTOOLPY_FLASHMODE_QIO=y
CONFIG_ESPTOOLPY_FLASHFREQ_80M=y
CONFIG_SPIRAM=y
CONFIG_SPIRAM_MODE_OCT=y
CONFIG_SPIRAM_SPEED_80M=y
CONFIG_SPIRAM_BOOT_INIT=y
CONFIG_SPIRAM_USE_MALLOC=y
CONFIG_ESP_DEFAULT_CPU_FREQ_MHZ_240=y
CONFIG_FREERTOS_HZ=1000
CONFIG_ESP_CONSOLE_UART_CUSTOM=y
CONFIG_ESP_CONSOLE_UART_CUSTOM_NUM_0=y
CONFIG_ESP_CONSOLE_UART_TX_GPIO=43
CONFIG_ESP_CONSOLE_UART_RX_GPIO=44
CONFIG_ESP_CONSOLE_SECONDARY_NONE=y
CONFIG_ESP_CONSOLE_UART_BAUDRATE=921600
CONFIG_LOG_DEFAULT_LEVEL_WARN=y
CONFIG_COMPILER_OPTIMIZATION_PERF=y
```
